#include "stm32f10x.h"
#include "bird.h"
#include "OLED.h"
#include "Key.h"
#include "delay.h"
#include "stdlib.h"

/* 依赖 menu_sub.c 的姿态解算 */
void MPU6050_Calculation(void);
extern float Pitch, Roll;

/*---------------- 图片素材（取自参考工程 1-9 陀螺仪小游戏） ----------------*/
/* 地面/顶部装饰带：256列 × 8像素，滚动使用 */
static const uint8_t bgGround[] = {
    0x0C,0xCC,0x4C,0x4C,0x4C,0x5C,0x4C,0x4C,0x2C,0x0C,0x0C,0x0C,0x0C,0x0E,0x0D,0x0D,
    0x0D,0x0D,0x0D,0x0D,0x0D,0x4D,0x0C,0x2C,0x0C,0x0C,0x0C,0x0C,0x0C,0x0C,0x0C,0x0C,
    0x0C,0x2C,0x0C,0x0C,0x0C,0x0C,0x0C,0x0C,0x0C,0x0C,0x0C,0x8C,0x8E,0x4E,0x4E,0x6E,
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    0x0C,0x1C,0x1C,0x1C,0x1C,0x1C,0x1C,0x1E,0x1E,0x1E,0x0F,0x0D,0x0D,0x0D,0x0D,0x0D
};

/* 障碍（仙人掌/石头）18x18，[0]=上方 [1]=下方 */
static const uint8_t bgBarrier1[2][54] = {
    {
        0x06,0x06,0x06,0x7C,0xC0,0x00,0x78,0x00,0x00,0xC0,0x00,0x00,0x00,0xE0,0x38,0x06,
        0x06,0x06,0x00,0x00,0x00,0x00,0x01,0x0F,0x38,0xC0,0x00,0x83,0x66,0x38,0x0F,0x01,
        0x00,0x00,0x00,0x00,0x00,0x00,0x00,0x00,0x00,0x00,0x00,0x01,0x03,0x01,0x00,0x00,
        0x00,0x00,0x00,0x00,0x00,0x00
    },
    {
        0x00,0x00,0x00,0x00,0x00,0x00,0xE0,0x38,0xC6,0x43,0x0E,0x70,0x80,0x00,0x00,0x00,
        0x00,0x00,0x80,0x80,0xC0,0x70,0x18,0x06,0x03,0x04,0x83,0xC0,0x20,0x00,0x0F,0x38,
        0xC0,0x80,0x80,0x80,0x01,0x01,0x01,0x00,0x00,0x00,0x00,0x00,0x00,0x00,0x00,0x00,
        0x00,0x00,0x01,0x01,0x01,0x01
    }
};

/* 小鸟 16x18 两帧（扇翅膀） */
static const uint8_t bgBird[2][48] = {
    {
        0x80,0x00,0x00,0x00,0x00,0x00,0x00,0x00,0x00,0x70,0xF8,0xF8,0xE8,0x70,0x60,0x20,
        0x03,0x02,0x0E,0x9E,0xFF,0xFF,0xFF,0x7F,0x3F,0x1F,0x0F,0x07,0x00,0x00,0x00,0x00,
        0x00,0x00,0x00,0x01,0x01,0x01,0x00,0x00,0x00,0x00,0x00,0x00,0x00,0x00,0x00,0x00
    },
    {
        0x80,0x1C,0x7C,0xFC,0xF8,0xF8,0xF0,0xE0,0x80,0x70,0xF8,0xF8,0xE8,0x70,0x60,0x20,
        0x03,0x02,0x0E,0x1E,0x1F,0x3F,0xFF,0xBF,0x3F,0x1F,0x0F,0x07,0x00,0x00,0x00,0x00,
        0x00,0x00,0x00,0x00,0x00,0x00,0x00,0x00,0x00,0x00,0x00,0x00,0x00,0x00,0x00,0x00
    }
};

typedef struct { uint8_t maxX, maxY, minX, minY; } Bird_Box;

static int score1;
static uint16_t Ground_pos1;
static uint8_t barrier_pos1[2];
static uint8_t barrier_pos2[2];
static Bird_Box up[2], down[2];
static Bird_Box bird;

/* 右上角分数 */
static void Bird_ShowScore(void)
{
    OLED_ShowNum(98, 28, score1, 5, OLED_6X8);
}

/* 顶部/底部滚动装饰带 */
static void Bird_ShowGround(void)
{
    uint8_t i;
    if (Ground_pos1 < 128)
    {
        for (i = 0; i < 128; i ++)
        {
            OLED_DisplayBuf[7][i] = bgGround[i + Ground_pos1];
            OLED_DisplayBuf[0][i] = bgGround[i + Ground_pos1];
        }
    }
    else
    {
        for (i = 0; i < 255 - Ground_pos1; i ++)
        {
            OLED_DisplayBuf[7][i] = bgGround[i + Ground_pos1];
            OLED_DisplayBuf[0][i] = bgGround[i + Ground_pos1];
        }
        for (i = 255 - Ground_pos1; i < 128; i ++)
        {
            OLED_DisplayBuf[7][i] = bgGround[i - (255 - Ground_pos1)];
            OLED_DisplayBuf[0][i] = bgGround[i - (255 - Ground_pos1)];
        }
    }
}

/* 障碍：2个下方 + 2个上方，并更新碰撞盒 */
static void Bird_ShowBarrier(void)
{
    uint8_t i;
    for (i = 0; i < 2; i ++)
    {
        OLED_ShowImage(127 - barrier_pos1[i], 42, 18, 18, bgBarrier1[1]); // 下方
        down[i].maxX = 127 - barrier_pos1[i] + 22;
        down[i].minX = 127 - barrier_pos1[i] + 2;
        down[i].maxY = 42 + 20;
        down[i].minY = 44;
    }
    for (i = 0; i < 2; i ++)
    {
        OLED_ShowImage(127 - barrier_pos2[i], 2, 18, 18, bgBarrier1[0]);  // 上方
        up[i].maxX = 127 - barrier_pos2[i] + 22;
        up[i].minX = 127 - barrier_pos2[i] + 2;
        up[i].maxY = 2 + 16;
        up[i].minY = 0;
    }
}

/* 小鸟：Roll 控制左右，Pitch 控制上下，score 奇偶切换翅膀 */
static void Bird_ShowBird(void)
{
    uint8_t Y;
    MPU6050_Calculation();
    Y = (uint8_t)(24 + Pitch);
    if (24 + Pitch >= 38) Y = 38;
    if (24 + Pitch <= 4)  Y = 4;

    OLED_ShowImage(8 - Roll, Y, 16, 18, bgBird[score1 % 2]);
    bird.maxX = 8 - Roll + 16;
    bird.minX = 8 - Roll + 0;
    bird.maxY = Y + 18;
    bird.minY = Y + 0;
}

static uint8_t Bird_Overlap(Bird_Box *a, Bird_Box *b)
{
    if ((a->maxX > b->minX) && (a->minX < b->maxX) &&
        (a->maxY > b->minY) && (a->minY < b->maxY)) return 1;
    return 0;
}

static uint8_t Bird_IsColliding(void)
{
    uint8_t i;
    for (i = 0; i < 2; i ++)
    {
        if (Bird_Overlap(&bird, &down[i]) || Bird_Overlap(&bird, &up[i])) return 1;
    }
    return 0;
}

/* 进入小游戏主循环：K3 返回游戏菜单 */
int BirdGame_Animation(void)
{
    uint8_t k;

    barrier_pos1[0] = 0;   barrier_pos1[1] = 100;
    barrier_pos2[0] = 50;  barrier_pos2[1] = 150;
    Bird_ShowBarrier();                 // 先建立一次碰撞盒

    while (1)
    {
        OLED_Clear();
        Bird_ShowScore();
        Bird_ShowGround();
        Bird_ShowBird();
        Bird_ShowBarrier();

        if (Bird_IsColliding())
        {
            OLED_Clear();
            OLED_ShowString(28, 24, "Game Over", OLED_8X16);
            OLED_Update();
            Delay_s(2);
            score1 = 0;
            barrier_pos1[0] = 0;   barrier_pos1[1] = 100;
            barrier_pos2[0] = 50;  barrier_pos2[1] = 150;
        }

        OLED_Update();

        k = Key_GetNum();
        if (k == 3) { OLED_Clear(); OLED_Update(); score1 = 0; return 0; }
    }
}

/* 1ms 定时中断里调用：滚动 + 计分 */
void Bird_Tick(void)
{
    static uint8_t score1_count, ground1_count;
    uint8_t i;

    score1_count ++;
    ground1_count ++;
    if (score1_count >= 100) { score1_count = 0; score1 ++; }

    if (ground1_count >= 20)
    {
        ground1_count = 0;
        Ground_pos1 ++;
        for (i = 0; i < 2; i ++)
        {
            barrier_pos1[i] ++;
            if (barrier_pos1[i] >= 256) barrier_pos1[i] = 0;
        }
        for (i = 0; i < 2; i ++)
        {
            barrier_pos2[i] ++;
            if (barrier_pos2[i] >= 256) barrier_pos2[i] = 0;
        }
    }
    if (Ground_pos1 >= 256) Ground_pos1 = 0;
}
